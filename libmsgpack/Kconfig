## libmsgpack/Kconfig
```kconfig
config LIB_MSGPACK
    bool "msgpack"
    default y
    depends on HAVE_LIBC
    select HAVE_LIB_MSGPACK
    help
        Library for MessagePack data format (http://msgpack.org/).

config HAVE_LIB_MSGPACK
    bool
```

## libusbdrivers/Kconfig
```kconfig
#
# Copyright 2014, NICTA
#
# This software may be distributed and modified according to the terms of
# the BSD 2-Clause license. Note that NO WARRANTY is provided.
# See "LICENSE_BSD2.txt" for details.
#
# @TAG(NICTA_BSD)
#

config LIB_USB
    bool "Build USB interface library"
    depends on HAVE_LIBC
    select LIB_PLATSUPPORT
    select LIB_PCI if ARCH_X86
    default y
```
